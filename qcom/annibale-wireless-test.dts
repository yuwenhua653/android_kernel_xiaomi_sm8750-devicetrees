// SPDX-License-Identifier: BSD-3-Clause
/* Annibale source qualification; bindings checked against OS4.0.6.0 DTBO. */
/dts-v1/;
/plugin/;
#include "wlan/annibale-kiwi-cnss.dtsi"
#include "bt/annibale-kiwi-bt.dtsi"

/ {
    model = "Qualcomm Technologies, Inc. Annibale based on SM8750";
    compatible = "qcom,sun-mtp", "qcom,sun", "qcom,sunp-mtp", "qcom,sunp", "qcom,mtp";
    qcom,msm-id = <618 0x10000>, <618 0x20000>, <639 0x10000>, <639 0x20000>,
                  <0x100026a 0x10000>, <0x100026a 0x20000>,
                  <0x100027f 0x10000>, <0x100027f 0x20000>;
    qcom,board-id = <0x40008 0>;
    xiaomi,miboard-id = <0xB 0>;
};

/* Preserve the revision-specific msm-id from the preceding media candidate. */
&{/} {
    model = "Qualcomm Technologies, Inc. Annibale based on SM8750";
    compatible = "qcom,sun-mtp", "qcom,sun", "qcom,sunp-mtp", "qcom,sunp", "qcom,mtp";
    qcom,board-id = <0x40008 0>;
    xiaomi,miboard-id = <0xB 0>;
};
