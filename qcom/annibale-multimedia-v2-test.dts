// SPDX-License-Identifier: BSD-3-Clause
/* Source qualification only: preserve Annibale selection, match SoC revision. */
/dts-v1/;
/plugin/;
#include <dt-bindings/interrupt-controller/arm-gic.h>
#include <dt-bindings/soc/qcom,ipcc.h>
#include <dt-bindings/interconnect/qcom,sun.h>
#include <dt-bindings/clock/qcom,videocc-sun.h>
#include <dt-bindings/clock/qcom,gcc-sun.h>
#include <dt-bindings/clock/qcom,evacc-sun.h>
#include <dt-bindings/arm/msm/qti-smmu-proxy-dt-ids.h>
#include "video/sun-vidc-v2.dtsi"
#include "eva/sun-eva-v2.dtsi"

/ {
    model = "Qualcomm Technologies, Inc. Annibale based on SM8750";
    compatible = "qcom,sun-mtp", "qcom,sun", "qcom,sunp-mtp", "qcom,sunp", "qcom,mtp";
    qcom,msm-id = <618 0x20000>, <639 0x20000>,
                  <0x100026a 0x20000>, <0x100027f 0x20000>;
    qcom,board-id = <0x40008 0>;
    xiaomi,miboard-id = <0xB 0>;
};

/* Root DTBO metadata selects this overlay; this fragment updates the result. */
&{/} {
    model = "Qualcomm Technologies, Inc. Annibale based on SM8750";
    compatible = "qcom,sun-mtp", "qcom,sun", "qcom,sunp-mtp", "qcom,sunp", "qcom,mtp";
    qcom,msm-id = <618 0x20000>, <639 0x20000>,
                  <0x100026a 0x20000>, <0x100027f 0x20000>;
    qcom,board-id = <0x40008 0>;
    xiaomi,miboard-id = <0xB 0>;
};
